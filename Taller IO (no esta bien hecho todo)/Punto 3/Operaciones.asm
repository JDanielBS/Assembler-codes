start:
	; Convertir puertos entradas
	ldi R16, 0b00001111
	STS DDRK, R16

	CLR R16
	OUT DDRF, R16
	; R18 SELECTOR
	; R16 NUM 1
	; R17 NUM 2
	; R20 RESULTADO

MAIN_MENU:
	RCALL SELECTOR
	CPI R18, 0
	BREQ SUMAR
	CPI R18, 1
	BREQ RESTAR
	CPI R18, 2
	BREQ AND_OPER
	CPI R18, 3
	BREQ OR_OPER

SELECTOR:
LDS  R18,PINK
ANDI R18, 0B11000000
SWAP R18
RET

LEER_DATOS:
IN R16, PINF
MOV R17, R16
ANDI R16, 0B00001111
ANDI R17, 0B11110000
SWAP R17
RET 


MOSTRAR_RESULTADO:
ANDI R20, 0B00001111
STS PORTK, R20
RET


SUMAR:
	RCALL LEER_DATOS
	CLR R20
	ADD R20, R16     ; R20 = R16 + R17
	ADD R20, R17
	RCALL MOSTRAR_RESULTADO
	RJMP MAIN_MENU

RESTAR:
	RCALL LEER_DATOS
	CLR R20
	MOV R20, R16     ; R20 = R16 - R17
	SUB R20, R17
	RCALL MOSTRAR_RESULTADO
	RJMP MAIN_MENU

AND_OPER:
	RCALL LEER_DATOS
	CLR R20
	MOV R20, R16     ; R20 = R16 AND R17
	AND R20, R17
	RCALL MOSTRAR_RESULTADO
	RJMP MAIN_MENU

OR_OPER:
	RCALL LEER_DATOS
	CLR R20
	MOV R20, R16     ; R20 = R16 OR R17
	OR R20, R17
	RCALL MOSTRAR_RESULTADO
	RJMP MAIN_MENU