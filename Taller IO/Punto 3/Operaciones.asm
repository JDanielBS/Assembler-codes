start:
	; Configurar puertos
	ldi R16, 0b00001111
	STS DDRK, R16

	CLR R16
	OUT DDRF, R16

	; R18: Selector
	; R16: Número 1
	; R17: Número 2
	; R20: Resultado

MAIN_MENU:
	RCALL SELECTOR
	CPI R18, 0x00
	BREQ SUMAR
	CPI R18, 0x40
	BREQ RESTAR
	CPI R18, 0x80
	BREQ AND_OPER
	CPI R18, 0xC0
	BREQ OR_OPER
	RJMP MAIN_MENU   ; Seguridad en caso de valor inesperado

SELECTOR:
	LDS R18, PINK
	ANDI R18, 0b11000000
	RET

LEER_DATOS:
	IN R16, PINF
	MOV R17, R16
	ANDI R16, 0b00001111       ; Extraer nibble bajo
	ANDI R17, 0b11110000       ; Extraer nibble alto
	SWAP R17                   ; Mover nibble alto a bajo
	RET

MOSTRAR_RESULTADO:
	ANDI R20, 0b00001111       ; Mostrar solo nibble bajo
	STS PORTK, R20
	RET

SUMAR:
	RCALL LEER_DATOS
	MOV R20, R16
	ADD R20, R17               ; R20 = R16 + R17
	RCALL MOSTRAR_RESULTADO
	RJMP MAIN_MENU

RESTAR:
	RCALL LEER_DATOS
	MOV R20, R16
	SUB R20, R17               ; R20 = R16 - R17
	RCALL MOSTRAR_RESULTADO
	RJMP MAIN_MENU

AND_OPER:
	RCALL LEER_DATOS
	MOV R20, R16
	AND R20, R17               ; R20 = R16 AND R17
	RCALL MOSTRAR_RESULTADO
	RJMP MAIN_MENU

OR_OPER:
	RCALL LEER_DATOS
	MOV R20, R16
	OR R20, R17                ; R20 = R16 OR R17
	RCALL MOSTRAR_RESULTADO
	RJMP MAIN_MENU